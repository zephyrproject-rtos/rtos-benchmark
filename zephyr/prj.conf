## CMakeLists.txt
```
## OLD
# cmake_minimum_required(VERSION 3.8.2)

# include($ENV{ZEPHYR_BASE}/cmake/app/boilerplate.cmake NO_POLICY_SCOPE)


cmake_minimum_required(VERSION 3.13.1)

find_package(Zephyr REQUIRED HINTS $ENV{ZEPHYR_BASE})

project(NONE)

set(SRC_DIR ../src/)
set(ZEPHYR_LAYER_SRC_DIR src/)

SET(SdkDirPath ${CMAKE_CURRENT_SOURCE_DIR}/../freertos/SDK_2.8.2_FRDM-K64F)

# target_sources(app PRIVATE ${SRC_DIR}/bench_cooperative_context_switch_test.c)
# target_sources(app PRIVATE ${SRC_DIR}/bench_interrupt_latency_test.c)
# target_sources(app PRIVATE ${SRC_DIR}/bench_interrupt_offload_latency_test.c)
# target_sources(app PRIVATE ${SRC_DIR}/bench_mutex_lock_unlock_test.c)
# target_sources(app PRIVATE ${SRC_DIR}/bench_sem_context_switch_test.c)
# target_sources(app PRIVATE ${SRC_DIR}/bench_sem_signal_release_test.c)
# target_sources(app PRIVATE ${SRC_DIR}/bench_thread_switch_yield_test.c)
# target_sources(app PRIVATE ${SRC_DIR}/bench_thread_test.c)
target_sources(app PRIVATE ${SRC_DIR}/bench_hello_world.c)

target_sources(app PRIVATE ${ZEPHYR_LAYER_SRC_DIR}/bench_porting_layer_zephyr.c)

target_compile_definitions(app PRIVATE ENABLE_PRINTF=1 ZEPHYR)
```

## prj.conf
```kconfig
CONFIG_STDOUT_CONSOLE=y

# (FROM LATENCY_MEASURE ZEPHYR TEST)
CONFIG_TEST=y

# eliminate timer interrupts during the benchmark
CONFIG_SYS_CLOCK_TICKS_PER_SEC=1
CONFIG_TICKLESS_KERNEL=n

# We use irq_offload(), enable it
CONFIG_IRQ_OFFLOAD=y

# Reduce memory/code footprint
CONFIG_BT=n
CONFIG_FORCE_NO_ASSERT=y

CONFIG_TEST_HW_STACK_PROTECTION=n
CONFIG_COVERAGE=n

# Disable system power management
CONFIG_PM=n

# Can only run under 1 CPU
CONFIG_MP_NUM_CPUS=1
CONFIG_TIMING_FUNCTIONS=y

# Memory for pointer chasing
CONFIG_HEAP_MEM_POOL_SIZE=4096
```

## src/bench_porting_layer_zephyr.c
```c
// SPDX-License-Identifier: Apache-2.0

#include "bench_api.h"
#include "bench_porting_layer_zephyr.h"
#include <zephyr.h>
#include <timing/timing.h>
#include <irq_offload.h>

/*
 * Constants.
 */
#define MAX_THREADS 10
#define STACK_SIZE 512
#define MAX_SEMAPHORES 2
#define MAX_MUTEXES 1

/*
 * Storage for data structures to be declared and used.
 *
 * For our implementation, the ID of a data structure is its position
 * in the array where it is stored.
 */
static K_THREAD_STACK_ARRAY_DEFINE(stacks, MAX_THREADS, STACK_SIZE);
static struct k_thread threads[MAX_THREADS];
static struct k_sem semaphores[MAX_SEMAPHORES];
static struct k_mutex mutexes[MAX_MUTEXES];
static struct k_work work;

void bench_test_init(void (*test_init_function)(void *))
{
	void *param = NULL;
	(test_init_function)(param);
}

void bench_thread_set_priority(int priority)
{
	k_thread_priority_set(k_current_get(), priority);
}

int bench_thread_create(int thread_id, const char *thread_name, int priority,
	void (*entry_function)(void *), void *args)
{
	ARG_UNUSED(args);

	if (thread_id >= 0 && thread_id < MAX_THREADS) {
		k_thread_create(&threads[thread_id], stacks[thread_id],
				STACK_SIZE,	(k_thread_entry_t) entry_function,
				NULL, NULL, NULL,
				priority, 0, K_FOREVER);
		k_thread_name_set(&threads[thread_id], thread_name);
		return BENCH_SUCCESS;
	} else {
		return BENCH_ERROR;
	}
}

void bench_thread_start(int thread_id)
{
	k_thread_start(&threads[thread_id]);
}

void bench_thread_resume(int thread_id)
{
	k_thread_resume(&threads[thread_id]);
}

void bench_thread_suspend(int thread_id)
{
	k_thread_suspend(&threads[thread_id]);
}

void bench_thread_abort(int thread_id)
{
	k_thread_abort(&threads[thread_id]);
}

void bench_yield(void)
{
	k_yield();
}

void bench_offload_setup(void)
{
	// Zephyr has a system workqueue; no setup is required to offload work
}

void bench_offload_create_work(void (*worker_function)(bench_work *))
{
	k_work_init(&work, (k_work_handler_t) worker_function);
}

void bench_offload_submit_work(void)
{
	k_work_submit(&work); // Submit work to system workqueue
}

void bench_timing_init(void)
{
	timing_init();
}

void bench_sync_ticks(void)
{
	k_sleep(K_TICKS(1));
}

void bench_timing_start(void)
{
	timing_start();
}

void bench_timing_stop(void)
{
	timing_stop();
}

bench_time_t bench_timing_counter_get(void)
{
	return timing_counter_get();
}

bench_time_t bench_timing_cycles_get(bench_time_t *time_start, bench_time_t *time_end)
{
	return timing_cycles_get(time_start, time_end);
}

bench_time_t bench_timing_cycles_to_ns(bench_time_t cycles)
{
	return timing_cycles_to_ns(cycles);
}

int bench_sem_create(int sem_id, int initial_count, int maximum_count)
{
	k_sem_init(&semaphores[sem_id], initial_count, maximum_count);
	return BENCH_SUCCESS;
}

void bench_sem_give(int sem_id)
{
	k_sem_give(&semaphores[sem_id]);
}

int bench_sem_take(int sem_id)
{
	k_sem_take(&semaphores[sem_id], K_FOREVER);
	return BENCH_SUCCESS;
}

int bench_mutex_create(int mutex_id)
{
	k_mutex_init(&mutexes[mutex_id]);
	return BENCH_SUCCESS;
}

int bench_mutex_lock(int mutex_id)
{
	k_mutex_lock(&mutexes[mutex_id], K_FOREVER);
	return BENCH_SUCCESS;
}

int bench_mutex_unlock(int mutex_id)
{
	k_mutex_unlock(&mutexes[mutex_id]);
	return BENCH_SUCCESS;
}

void *bench_malloc(size_t size)
{
	return k_malloc(size);
}

void bench_free(void *ptr)
{
	k_free(ptr);
}

void bench_thread_exit(void)
{
	// NO-op on Zephyr
}

void bench_sleep(uint32_t msec)
{
	if (msec == 0)
		return;

	k_sleep(K_MSEC(msec));
}
```

## src/bench_porting_layer_zephyr.h
```c
/* SPDX-License-Identifier: Apache-2.0 */

#ifndef PORTING_LAYER_ZEPHYR_H_
#define PORTING_LAYER_ZEPHYR_H_

#include <zephyr.h>
#include <kernel.h>
#include <timing/timing.h>
#include <stdio.h>

typedef timing_t bench_time_t;
typedef struct k_work bench_work;

#define TICK_SYNCH()  k_sleep(K_TICKS(1))

#define PRINTF(FMT, ...) printk(FMT, ##__VA_ARGS__)

#endif
```
