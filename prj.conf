## CMakeLists.txt
```
cmake_minimum_required(VERSION 3.22)

set(AVAILABLE_TESTS
    interrupt_latency
    malloc_free
    message_queue
    mutex_lock_unlock
    sem_context_switch
    sem_signal_release
    thread_switch_yield
    thread)

set(AVAILABLE_RTOSES
    zephyr
    freertos)

set(ITERATIONS 10000 CACHE STRING "Number of iterations for each test")
set(CMAKE_C_FLAGS "${CMAKE_C_FLAGS} -DITERATIONS=${ITERATIONS}")

set(CALIBRATION_LOOPS 10000 CACHE STRING "Number of calibration loops for each test")
set(CMAKE_C_FLAGS "${CMAKE_C_FLAGS} -DCALIBRATION_LOOPS=${CALIBRATION_LOOPS}")

if (NOT RTOS IN_LIST AVAILABLE_RTOSES)
    message(FATAL_ERROR "Choose either [zephyr] or [freertos]")
endif()

# Add include directory for bench_api.h and bench_utils.h
include_directories(h)

# Include any ${RTOS} specific build rules
include(src/${RTOS}/${RTOS}.cmake)
add_subdirectory(src/${RTOS})

project(bench)

list(LENGTH TEST tests_to_run)
if (${tests_to_run} EQUAL 0)
    list(TRANSFORM AVAILABLE_TESTS REPLACE "(.+)" "src/common/bench_\\1_test.c" OUTPUT_VARIABLE sources)

    target_sources(app PRIVATE ${sources})
    target_sources(app PRIVATE src/common/bench_utils.c)
    target_sources(app PRIVATE src/common/bench_all.c)

    return()
endif()

if(NOT ${tests_to_run} EQUAL 1)
    message(FATAL_ERROR "Choose exactly one test")
endif()

if (NOT ${TEST} IN_LIST AVAILABLE_TESTS)
    list(JOIN AVAILABLE_TESTS "\n" pretty_print)
    message(FATAL_ERROR "Choose one test from:\n${pretty_print}")
endif()

string(TOUPPER ${TEST} test_upper)
set(CMAKE_C_FLAGS "${CMAKE_C_FLAGS} -DRUN_${test_upper}")
target_sources(app PRIVATE src/common/bench_utils.c)
target_sources(app PRIVATE src/common/bench_${TEST}_test.c)
```

## prj.conf
```kconfig
CONFIG_STDOUT_CONSOLE=y

# (FROM LATENCY_MEASURE ZEPHYR TEST)
# eliminate timer interrupts during the benchmark
CONFIG_SYS_CLOCK_TICKS_PER_SEC=1
CONFIG_TICKLESS_KERNEL=n

# We use irq_offload(), enable it
CONFIG_IRQ_OFFLOAD=y

# Reduce memory/code footprint
CONFIG_BT=n
CONFIG_FORCE_NO_ASSERT=y

CONFIG_TEST_HW_STACK_PROTECTION=n
CONFIG_COVERAGE=n

# Disable system power management
CONFIG_SYS_POWER_MANAGEMENT=n

# Can only run under 1 CPU
CONFIG_MP_NUM_CPUS=1
CONFIG_TIMING_FUNCTIONS=y
```

## src/bench_all.c
```c
// SPDX-License-Identifier: Apache-2.0

#include "bench_api.h"
#include "bench_utils.h"

extern void bench_basic_thread_ops(void *arg);
extern void bench_interrupt_latency_test(void *arg);
extern void bench_mutex_lock_unlock_test(void *arg);
extern void bench_sem_context_switch_init(void *arg);
extern void bench_sem_signal_release_init(void *arg);
extern void bench_thread_yield(void *arg);

void bench_all(void *arg)
{
	BENCH_PRINTF("\n *** Starting! ***\n\n");

	bench_basic_thread_ops(arg);
	bench_mutex_lock_unlock_test(arg);
	bench_sem_context_switch_init(arg);
	bench_sem_signal_release_init(arg);
	bench_thread_yield(arg);
	bench_interrupt_latency_test(arg);

	BENCH_PRINTF("\n *** Done! ***\n");
}

int main(void)
{
	bench_test_init(bench_all);
	return 0;
}
```

## src/bench_api.h
```c
/* SPDX-License-Identifier: Apache-2.0 */

#ifndef  BENCH_API_H
#define  BENCH_API_H

#define BENCH_SUCCESS 0 /* Value returned when operation succeeds */
#define BENCH_ERROR 1 /* Value returned when operation fails */

#include "bench_porting_layer_zephyr.h"

/**
 * @brief Call test initialization function
 *
 * This routine calls the initialization function of the test.
 *
 * @param test_init_function     The test initialization function
 */
void bench_test_init(void (*test_init_function)(void));

/**
 * @brief Set priority of current thread
 *
 * This routine immediately changes the priority of the current thread.
 *
 * @param priority New priority
 */
void bench_thread_set_priority(int priority);

/**
 * @brief Create a thread and set its name
 *
 * This routine initializes a thread and sets its name. It does not schedule the thread.
 *
 * @param thread_id       Handle for thread.
 * @param thread_name     Name of thread.
 * @param priority        Thread priority.
 * @param entry_function  Thread entry function.
 * @param args            Entry point parameter representing arguments.
 *
 * @return BENCH_SUCCESS on success or BENCH_FAILURE on failure
 */
int bench_thread_create(int thread_id, const char *thread_name, int priority,
	void (*entry_function)(void *), void *args);

/**
 * @brief Start an initialized but unstarted thread
 *
 * This routine starts the thread by adding it to the scheduler queue for the first time.
 *
 * @param thread_id Handle of thread
 */
void bench_thread_start(int thread_id);

/**
 * @brief Resume a suspended thread
 *
 * This routine resumes a thread that has been suspended.
 *
 * @param thread_id Handle of thread
 */
void bench_thread_resume(int thread_id);

/**
 * @brief Suspend a thread.
 *
 * This routine suspends the thread.
 *
 * @param thread_id Handle of thread
 */
void bench_thread_suspend(int thread_id);

/**
 * @brief Abort a thread
 *
 * This routine aborts the thread.
 *
 * @param thread_id Handle of thread
 */
void bench_thread_abort(int thread_id);

/**
 * @brief Yield the current thread
 *
 * This routine causes the current thread to yield execution to another thread of
 * the same or higher priority.
 */
void bench_yield(void);

/**
 * @brief Set up to offload work from ISR
 *
 * This routine performs setup to enable \ref bench_offload_submit_work to
 * offload work from ISR to another thread, such as setting up a workqueue to place work items into.
 */
void bench_offload_setup(void);

/**
 * @brief Initialize the work item representing work to be offloaded from ISR
 *
 * This routine initializes and stores the work item that represents the work to be offloaded.
 *
 * @param worker_function Function to call
 */
void bench_offload_create_work(void (*worker_function)(bench_work *));

/**
 * @brief Offload work from ISR
 *
 * This routine executes the stored work item on another thread from ISR.
 */
void bench_offload_submit_work(void);


/**
 * @brief Initialize timing
 *
 * This routine performs setup to enable \ref bench_timing_start.
 */
void bench_timing_init(void);

/**
 * @brief Synchronize ticks
 *
 * This routine synchronizes ticks by sleeping a tick.
 */
void bench_sync_ticks(void);

/**
 * @brief Start timing
 *
 * This routine performs setup to enable routines that get time measurements.
 */
void bench_timing_start(void);

/**
 * @brief Stop timing
 *
 * This routine performs setup to disable routines that get time measurements.
 */
void bench_timing_stop(void);

/**
 * @brief Read the hardware clock
 *
 * This routine returns the current time, as measured by the system's hardware clock.
 *
 * @return Current hardware clock up counter (in cycles)
 */
bench_time_t bench_timing_counter_get(void);

/**
 * @brief Get number of cycles between @p time_start and @p time_end
 *
 * @param time_start Pointer to counter at start of a measured execution
 * @param time_end Pointer to counter at stop of a measured execution
 * @return Number of cycles between start and end
 */
uint32_t bench_timing_cycles_get(bench_time_t *time_start, bench_time_t *time_end);

/**
 * @brief Convert number of @p cycles into nanoseconds
 *
 * @param cycles Number of cycles
 * @return Converted time value
 */
uint64_t bench_timing_cycles_to_ns(uint64_t cycles);

/**
 * @brief Create a semaphore
 *
 * This routine initializes a semaphore object, prior to its first use.
 *
 * @param sem_id          ID of semaphore (to be used with other routines)
 * @param initial_count   Initial semaphore count
 * @param maximum_count   Maximum permitted semaphore count
 * @return BENCH_SUCCESS on success or BENCH_FAILURE on failure
 */
int bench_sem_create(int sem_id, int initial_count, int maximum_count);

/**
 * @brief Give a semaphore
 *
 * This routine gives the semaphore, unless the semaphore is already at its maximum permitted count.
 *
 * @param sem_id ID of semaphore
 */
void bench_sem_give(int sem_id);

/**
 * @brief Take a semaphore
 *
 * This routine takes the semaphore without any timeout period. If the semaphore is
 * never incremented, the routine will wait forever.
 *
 * @param sem_id ID of semaphore
 * @return BENCH_SUCCESS on success or BENCH_FAILURE on failure
 */
int bench_sem_take(int sem_id);

/**
 * @brief Create a mutex
 *
 * This routine creates a mutex object, prior to its first use.
 *
 * @param mutex_id ID of mutex (to be used with other routines)
 * @return BENCH_SUCCESS on success or BENCH_FAILURE on failure
 */
int bench_mutex_create(int mutex_id);

/**
 * @brief Lock a mutex
 *
 * This routine locks a mutex.
 *
 * @param mutex_id ID of mutex
 * @return BENCH_SUCCESS on success or BENCH_FAILURE on failure
 */
int bench_mutex_lock(int mutex_id);

/**
 * @brief Unlock a mutex
 *
 * This routine unlocks a mutex.
 *
 * @param mutex_id ID of mutex
 * @return BENCH_SUCCESS on success or BENCH_FAILURE on failure
 */
int bench_mutex_unlock(int mutex_id);

/**
 * @brief Run a function in interrupt context
 *
 * This function synchronously runs the provided function in interrupt
 * context, passing in the supplied device.
 *
 * @param irq_offload_routine The function to run
 * @param parameter Argument to pass to the function when it is run as an
 * interrupt
 */
void bench_irq_offload(const void *irq_offload_routine, const void *parameter);

#endif
```

## src/bench_cooperative_context_switch_test.c
```c
// SPDX-License-Identifier: Apache-2.0

/**
 * @file
 *
 * @brief Measure context switch time between cooperative threads
 *
 * This file contains thread (coop) context switch time measurement.
 * The thread starts two cooperative thread. One thread waits on a semaphore. The other,
 * after starting, releases a semaphore which enable the first thread to run.
 * Each thread increases a common global counter and context switch back and
 * forth by yielding the cpu. When counter reaches the maximal value, threads
 * stop and the average time of context switch is displayed.
 */

#include "bench_api.h"
#include "bench_utils.h"

#define NCTXSWITCH 10000 /* Number of context switches */

static bench_time_t timestamp_start;
static bench_time_t timestamp_end;

/* Context switches counter */
static volatile uint32_t ctx_switch_counter;

/* Context switch balancer. Incremented by one thread, decremented by another. */
static volatile int ctx_switch_balancer;

/**
 * @brief Measure time at beginning and end of context switching through yields
 *
 * The average time to context switch will be calculated by dividing by number
 * of context switches.
 */
static void bench_thread_one(void *args)
{
	ARG_UNUSED(args);

	bench_sem_take(0);

	timestamp_start = bench_timing_counter_get();

	while (ctx_switch_counter < NCTXSWITCH) {
		bench_yield();
		ctx_switch_counter++;
		ctx_switch_balancer--;
	}

	timestamp_end = bench_timing_counter_get();
}

/**
 * @brief Check the time when it gets executed after the semaphore
 *
 * Fiber starts, waits on semaphore. When the interrupt handler releases
 * the semaphore, other thread measures the time.
 */
static void bench_thread_two(void *args)
{
	ARG_UNUSED(args);

	bench_sem_give(0);

	while (ctx_switch_counter < NCTXSWITCH) {
		bench_yield();
		ctx_switch_counter++;
		ctx_switch_balancer++;
	}
}

/**
 *
 * @brief The test main function
 */
void bench_coop_ctx_switch(void)
{
	ctx_switch_counter = 0U;
	ctx_switch_balancer = 0;

	bench_timing_start();

	bench_thread_create(0, "t1", 6, bench_thread_one, NULL);
	bench_thread_start(0);

	bench_thread_create(1, "t2", 6, bench_thread_two, NULL);
	bench_thread_start(1);

	if (ctx_switch_balancer > 3 || ctx_switch_balancer < -3) {
		printf("Balance is %d. FAILED", ctx_switch_balancer);
	// MISSING ERROR CHECK
	} else {
		uint32_t diff;

		diff = bench_timing_cycles_get(&timestamp_start, &timestamp_end);
		PRINT_STATS_AVG("Average context switch time between threads (coop)",
			diff, ctx_switch_counter);
	}

	bench_timing_stop();
}

void bench_interrupt_latency_init(void *arg)
{
	bench_timing_init();

	/* Ensure test main thread has lower priority than switching threads */
	bench_thread_set_priority(10);
	bench_sem_create(0, 0, 1);

	bench_coop_ctx_switch();
}

int main(void)
{
	bench_test_init(bench_interrupt_latency_init);
	return 0;
}
```

## src/bench_hello_world.c
```c
#include "bench_api.h"
#include "bench_utils.h"

bench_time_t timestamp_start_greeting;
bench_time_t timestamp_end_greeting;

void bench_hello(void)
{
	uint32_t diff;

	bench_timing_start();

	timestamp_start_greeting = bench_timing_counter_get();
	PRINT("Hello, world!\n");
	timestamp_end_greeting = bench_timing_counter_get();

	diff = bench_timing_cycles_get(&timestamp_start_greeting, &timestamp_end_greeting);
	PRINT_STATS("Time to greet", diff);

	PRINT_STATS_AVG("Average time to greet (with 1 sample)", diff, 1);

	bench_timing_stop();
}

/**
 * @brief Test setup function
 */
void bench_hello_init(void *arg)
{
	bench_timing_init();

	bench_hello();
}

int main(void)
{
	bench_test_init(bench_hello_init);
	return 0;
}
```

## src/bench_interrupt_latency_test.c
```c
// SPDX-License-Identifier: Apache-2.0

/**
 * @file
 *
 * @brief Measure time from ISR back to interrupted thread
 *
 * This file contains test that measures time to switch from the interrupt
 * handler back to the interrupted thread.
 */

#include "bench_api.h"
#include "bench_utils.h"

static volatile int flag_var;

static bench_time_t timestamp_start;
static bench_time_t timestamp_end;

/**
 *
 * @brief Test ISR used to measure best case interrupt latency
 *
 * The interrupt handler gets the first timestamp.
 */
static void bench_latency_test_isr(const void *unused)
{
	ARG_UNUSED(unused);
	flag_var = 1;

	timestamp_start = bench_timing_counter_get(); // End of ISR
}

/**
 * @brief Register ISR and invoke software interrupt.
 *
 * Function makes all test preparations: registering interrupt handler,
 * invoking software interrupt, and getting second timestamp.
 */
static void bench_make_interrupt(void)
{
	flag_var = 0;

	irq_offload(bench_latency_test_isr, NULL);

	if (flag_var != 1) {
		printf("Flag variable has not changed. Interrupt latency test FAILED\n");
	} else {
		timestamp_end = bench_timing_counter_get(); // Resume from ISR
	}
}

/**
 * @brief Test main function
 */
void bench_interrupt_to_thread(void)
{
	uint32_t diff;

	bench_timing_start();
	bench_sync_ticks();

	bench_make_interrupt();

	if (flag_var == 1) {
		diff = bench_timing_cycles_get(&timestamp_start, &timestamp_end);
		PRINT_STATS("Switch from ISR back to interrupted thread", diff);
	}

	bench_timing_stop();
}

/**
 * @brief Test setup function
 */
void bench_interrupt_latency_init(void)
{
	bench_timing_init();

	bench_interrupt_to_thread();
}

int main(void)
{
	bench_test_init(bench_interrupt_latency_init);
	return 0;
}
```

## src/bench_interrupt_offload_latency_test.c
```c
// SPDX-License-Identifier: Apache-2.0

#include "bench_api.h"
#include "bench_utils.h"

static bench_time_t timestamp_start;
static bench_time_t timestamp_end;

static void bench_latency_test_isr(const void *unused)
{
	ARG_UNUSED(unused);

	bench_offload_submit_work();

	timestamp_start = bench_timing_counter_get();
}

static void bench_worker(bench_work *item)
{
	(void)item;

	timestamp_end = bench_timing_counter_get();

	bench_sem_give(1);
}

void bench_generate_interrupt_thread(void)
{
	bench_sem_take(0);
	irq_offload(bench_latency_test_isr, NULL);
	bench_thread_suspend(0);
}

void bench_interrupt_offload_latency_init(void)
{
	bench_timing_init();

	bench_sem_create(0, 0, 1); // Interrupt semaphore
	bench_sem_create(1, 0, 1); // Worker semaphore

	bench_thread_create(0, "gen_int_thread", 1, bench_generate_interrupt_thread);
	bench_thread_resume(0);

	uint32_t diff;

	bench_offload_create_work(bench_worker);

	bench_timing_start();
	TICK_SYNCH();

	bench_sem_give(0); // Give on interrupt semaphore
	bench_sem_take(1); // Take on worker semaphore

	bench_timing_stop();

	diff = timing_cycles_get(&timestamp_start, &timestamp_end);

	PRINT_STATS("Time from ISR to executing a different thread", diff)
}

int main(void)
{
	bench_test_init(bench_interrupt_offload_latency_init);
	return 0;
}
```

## src/bench_mutex_lock_unlock_test.c
```c
// SPDX-License-Identifier: Apache-2.0

/**
 * @file Measure time for mutex lock and unlock
 *
 * This file contains the test that measures the time to both lock and unlock
 * a mutex under various conditions.
 * 1. Time to lock and unlock a mutex
 * 2. Time to recursively lock and unlock a mutex
 * 3. Time to unlock a mutex and unpend a lower priority thread
 * 4. Time to unlock a mutex and unpend a higher priority thread
 * 5. Time to pend on a mutex without priority inheritance
 * 6. Time to pend on a mutex with priority inheritance
 */

#include "bench_api.h"
#include "bench_utils.h"

#define MUTEX_ID      0

#define SEM_ID        1

#define THREAD_LOW  0       /* Low priority thread ID */
#define THREAD_HIGH 1       /* High priority thread ID */

#define MAIN_PRIORITY   (BENCH_LAST_PRIORITY - 2)

#define TIME_TO_LOCK                0
#define TIME_TO_UNLOCK              1
#define TIME_TO_RECURSIVELY_LOCK    2
#define TIME_TO_RECURSIVELY_UNLOCK  3
#define TIME_TO_UNPEND              4
#define TIME_TO_UNPEND_PRI_INH      5
#define TIME_TO_PEND                6
#define TIME_TO_PEND_PRI_INH        7

#define NUM_TIMES  8

static struct bench_stats times[NUM_TIMES];

static bench_time_t  helper_start;
static bench_time_t  helper_end;

static const char *report_strings[NUM_TIMES] = {
    "1. Lock an unowned mutex: min %llu ns, max %llu ns, avg %llu ns\n",
    "2. Unlock a mutex (no waiters): min %llu ns, max %llu ns, avg %llu ns\n",
    "3. Recursively lock a mutex: min %llu ns, max %llu ns, avg %llu ns\n",
    "4. Recursively unlock a mutex: min %llu ns, max %llu ns, avg %llu ns\n",
    "5. Unlock a mutex and unpend thread (no ctx switch): min %llu ns, max %llu ns, avg %llu ns\n",
    "6. Unlock a mutex and unpend thread (with ctx switch): min %llu ns, max %llu ns, avg %llu ns\n",
    "7. Pend on a mutex (no priority inheritance): min %llu ns, max %llu ns, avg %llu ns\n",
    "8. Pend on a mutex (priority inheritance): min %llu ns, max %llu ns, avg %llu ns\n",
};

/**
 * @brief Reset time statistics
 */
static void reset_time_stats()
{
	for (unsigned i = 0; i < NUM_TIMES; i++) {
		bench_stats_reset(&times[i]);
	}
}

/**
 * @brief Report the collected statistics
 */
static void report_stats(void)
{
	int i;

	for (i = 0; i < NUM_TIMES; i++) {
		PRINTF(report_strings[i],
		       bench_timing_cycles_to_ns(times[i].min),
		       bench_timing_cycles_to_ns(times[i].max),
		       bench_timing_cycles_to_ns(times[i].avg));
	}
}

/**
 * @brief Gather stats for locking/unlocking a mutex
 *
 * Gathers stats for locking an unowned mutex and for unlocking a mutex
 * with no waiters.
 */
static void gather_lock_unlock_stats(uint32_t iteration)
{
	bench_time_t  start;
	bench_time_t  mid;
	bench_time_t  end;

	start = bench_timing_counter_get();
	bench_mutex_lock(MUTEX_ID);
	mid   = bench_timing_counter_get();
	bench_mutex_unlock(MUTEX_ID);
	end   = bench_timing_counter_get();

	bench_stats_update(&times[TIME_TO_LOCK],
			   bench_timing_cycles_get(&start, &mid),
			   iteration);

	bench_stats_update(&times[TIME_TO_UNLOCK],
			   bench_timing_cycles_get(&mid, &end),
			   iteration);
}

/**
 * @brief Gather stats for recursively locking a mutex
 */
static void gather_recursive_lock_stats(uint32_t iteration)
{
	bench_time_t  start;
	bench_time_t  end;

	start = bench_timing_counter_get();
	bench_mutex_lock(MUTEX_ID);
	end = bench_timing_counter_get();

	bench_stats_update(&times[TIME_TO_RECURSIVELY_LOCK],
			   bench_timing_cycles_get(&start, &end),
			   iteration);
}

/**
 * @brief Gather stats for recursively unlocking a mutex
 *
 * The mutex was previously recursively locked.
 */
static void gather_recursive_unlock_stats(uint32_t iteration)
{
	bench_time_t  start;
	bench_time_t  end;

	start = bench_timing_counter_get();
	bench_mutex_unlock(MUTEX_ID);
	end = bench_timing_counter_get();
	bench_stats_update(&times[TIME_TO_RECURSIVELY_UNLOCK],
			   bench_timing_cycles_get(&start, &end),
			   iteration);
}

/**
 * @brief Entry point to helper thread to gather_unpend_stats()
 *
 * This helper thread is used by two different unlock+unpend tests. The
 * global variable <helper_end> is only relevant to the case that involves
 * priority inheritance.
 */
static void bench_unpend_helper(void *args)
{
	ARG_UNUSED(args);

	/* MUTEX_ID is expected to be owned by the main thread. */

	bench_mutex_lock(MUTEX_ID);

	helper_end = bench_timing_counter_get();

	bench_mutex_unlock(MUTEX_ID);
}

/**
 * @brief Gather stats for an unlock that unpends a blocked low priority thread
 */
static void gather_unpend_stats(int priority, uint32_t iteration)
{
	bench_time_t  start;
	bench_time_t  end;

	bench_mutex_lock(MUTEX_ID);

	bench_thread_create(THREAD_LOW, "thread_low",
			    priority, bench_unpend_helper, NULL);
	
	bench_thread_start(THREAD_LOW);

	bench_yield();       /* Yield to helper */

	/*
	 * Helper thread is expected to be pending on MUTEX_ID.
	 * Unlocking MUTEX_ID will give it to the helper thread, but
	 * there will not be any thread context switch.
	 */

	start = bench_timing_counter_get();
	bench_mutex_unlock(MUTEX_ID);
	end = bench_timing_counter_get();

	bench_stats_update(&times[TIME_TO_UNPEND],
			   bench_timing_cycles_get(&start, &end),
			   iteration);

	/*
	 * Lower the priority of the current thread to ensure the
	 * helper thread executes to completion.
	 */

	bench_thread_set_priority(priority + 2);

	/* Restore current thread priority */

	bench_thread_set_priority(priority);
}

/**
 * @brief Unlock a mutex that unpends a blocked higher priority thread
 */
static void gather_unpend_inheritance_stats(int priority, uint32_t iteration)
{
	bench_time_t  start;

	bench_mutex_lock(MUTEX_ID);

	bench_thread_create(THREAD_HIGH, "thread_high",
			    priority - 1, bench_unpend_helper, NULL);
	
	bench_thread_start(THREAD_HIGH);

	/*
	 * Helper thread is expected to be pending on MUTEX_ID.
	 * Unlocking MUTEX_ID will give it to the helper thread, which
	 * is expected to run to completion.
	 */

	start = bench_timing_counter_get();
	bench_mutex_unlock(MUTEX_ID);

	bench_stats_update(&times[TIME_TO_UNPEND_PRI_INH],
			   bench_timing_cycles_get(&start, &helper_end),
			   iteration);
}

/**
 * @brief Low priority helper thread
 */
static void bench_pend_low(void *args)
{
	ARG_UNUSED(args);

	/* Step 2 */

	bench_sem_give(SEM_ID);

	/* Step 5 */

	helper_end = bench_timing_counter_get();

	bench_sem_give(SEM_ID);    /* Unblock the main thread */

	/* Step 8 - clean up and finish */
}

/**
 * @brief High priority helper thread
 */
static void bench_pend_high(void *args)
{
	/* Step 4 */

	helper_start = bench_timing_counter_get();

	bench_mutex_lock(MUTEX_ID);

	/* Step 7 - clean up and finish */

	bench_mutex_unlock(MUTEX_ID);
}

/**
 * @brief Determine time to pend on a mutex (no priority inheritance)
 *
 * To measure the time to pend on a mutex that does not involve priority
 * inheritance requires three threads, two of which (THREAD_HIGH and
 * THREAD_LOW) are of lower priority than the main thread.
 *
 * 1. Main thread locks the mutex
 * 2. THREAD_HIGH pends on the mutex
 * 3. THREAD_LOW gets the final timestamp
 *
 * Execution order is ...
 *
 * 1. Main thread (locks mutex)
 * 2. Low priority helper (execute to known point)
 * 3. Main thread
 * 4. High priority helper (blocks on locking mutex)
 * 5. Low priority helper (unblocks main thread)
 * 6. Main thread (unblocks high priority helper, lowers own priority)
 * 7. High priority helper (cleans up and finishes)
 * 8. Low priority helper (finishes)
 * 9. Main thread (restores priority and finishes)
 */
static void gather_pend_stats(int priority, uint32_t iteration)
{
	/* Step 1 */

	bench_mutex_lock(MUTEX_ID);

	bench_thread_create(THREAD_LOW, "thread_low",
			    priority + 2, bench_pend_low, NULL);
	bench_thread_start(THREAD_LOW);

	bench_sem_take(SEM_ID);    /* Switch to low priority helper */

	/* Step 3 */

	bench_thread_create(THREAD_HIGH, "thread_high",
			    priority + 1, bench_pend_high, NULL);
	bench_thread_start(THREAD_HIGH);

	bench_sem_take(SEM_ID);    /* Block so high priority helper runs */

	/* Step 6. */

	bench_stats_update(&times[TIME_TO_PEND],
			   bench_timing_cycles_get(&helper_start, &helper_end),
			   iteration);

	bench_mutex_unlock(MUTEX_ID);

	bench_thread_set_priority(priority + 3);

	/* Step 9 */

	bench_thread_set_priority(priority);
}

/**
 * @brief Determine time to pend on a mutex (with priority inheritance)
 *
 * To measure the time to pend on a mutex that involves priority inheritance
 * requires two threads--a high priority helper and the main thread.
 *
 * Execution order is ...
 *
 * 1. Main thread (locks mutex)
 * 4. High priority helper (blocks on locking mutex)
 * 5. Main thread unlocks mutex (unblocking high priority helper)
 * 7. High priority helper (cleans up and finishes)
 * 8. Main thread (cleans up and finishes)
 *
 * It is recognized that the enumeration of steps above may appear off.
 * This is done to remain consistent with the numbering and comments used
 * by gather_pend_stats() and its helper routines.
 */
static void gather_pend_inheritance_stats(int priority, uint32_t iteration)
{
	bench_time_t  end;

	/* Step 1 */

	bench_mutex_lock(MUTEX_ID);

	bench_thread_create(THREAD_HIGH, "thread_high",
			    priority - 1, bench_pend_high, NULL);
	bench_thread_start(THREAD_HIGH);

	end = bench_timing_counter_get();

	/* Step 5 */

	bench_mutex_unlock(MUTEX_ID);

	/* Step 8 */

	bench_stats_update(&times[TIME_TO_PEND_PRI_INH],
			   bench_timing_cycles_get(&helper_start, &end),
			   iteration);
}

/**
 * @brief Test setup function
 */
void bench_mutex_lock_unlock_test(void *arg)
{
	uint32_t  i;

	bench_mutex_create(MUTEX_ID);
	bench_sem_create(SEM_ID, 0, 1);

	bench_thread_set_priority(MAIN_PRIORITY);

	bench_timing_init();
	bench_timing_start();

	reset_time_stats();

	for (i = 1; i <= ITERATIONS; i++) {
		gather_lock_unlock_stats(i);
	}

	bench_mutex_lock(MUTEX_ID);        /* Prep mutex so it is locked */

	for (i = 1; i <= ITERATIONS; i++) {
		gather_recursive_lock_stats(i);
	}

	for (i = 1; i <= ITERATIONS; i++) {
		gather_recursive_unlock_stats(i);
	}

	bench_mutex_unlock(MUTEX_ID);      /* Undo final lock */

	for (i = 1; i <= ITERATIONS; i++) {
		gather_unpend_stats(MAIN_PRIORITY, i);
	}

	for (i = 1; i <= ITERATIONS; i++) {
		gather_unpend_inheritance_stats(MAIN_PRIORITY, i);
	}

	for (i = 1; i <= ITERATIONS; i++) {
		gather_pend_stats(MAIN_PRIORITY, i);
	}

	for (i = 1; i <= ITERATIONS; i++) {
		gather_pend_inheritance_stats(MAIN_PRIORITY, i);
	}

	report_stats();
	bench_timing_stop();
}

#ifdef RUN_MUTEX_LOCK_UNLOCK
int main(void)
{
	bench_test_init(bench_mutex_lock_unlock_test);
	return 0;
}
#endif
```

## src/bench_porting_layer_zephyr.c
```c
// SPDX-License-Identifier: Apache-2.0

#include "bench_api.h"
#include "bench_porting_layer_zephyr.h"
#include <zephyr.h>
#include <timing/timing.h>
#include <irq_offload.h>

#define MAX_THREADS 10
#define STACK_SIZE 512
#define MAX_SEMAPHORES 2
#define MAX_MUTEXES 1

static K_THREAD_STACK_ARRAY_DEFINE(stacks, MAX_THREADS, STACK_SIZE);
static struct k_thread threads[MAX_THREADS];
static struct k_sem semaphores[MAX_SEMAPHORES];
static struct k_mutex mutexes[MAX_MUTEXES];
static struct k_work work;

void bench_test_init(void (*test_init_function)(void))
{
	(test_init_function)();
}

void bench_set_current_thread_prio(int prio)
{
	k_thread_priority_set(k_current_get(), prio);
}

int bench_thread_create(int thread_id, const char *thread_name, int priority,
		void (*entry_function)(void))
{
	if (thread_id >= 0 && thread_id < MAX_THREADS) {
		k_thread_create(&threads[thread_id], stacks[thread_id],
				STACK_SIZE,	(k_thread_entry_t) entry_function,
				NULL, NULL, NULL,
				priority, 0, K_FOREVER);
		k_thread_name_set(&threads[thread_id], thread_name);
		return BENCH_SUCCESS;
	} else {
		return BENCH_ERROR;
	}
}

int bench_thread_resume(int thread_id)
{
	struct k_thread *thread;

	thread = &threads[thread_id];

	if (thread->base.thread_state & _THREAD_PRESTART) {
		k_thread_start(thread);
	} else {
		k_thread_resume(thread);
	}

	return BENCH_SUCCESS;
}

int bench_thread_suspend(int thread_id)
{
	k_thread_suspend(&threads[thread_id]);
	return BENCH_SUCCESS;
}

int bench_thread_abort(int thread_id)
{
	k_thread_abort(&threads[thread_id]);
	return BENCH_SUCCESS;
}

void bench_yield(void)
{
	k_yield();
}

int bench_offload_setup(void)
{
	// Zephyr provides system workqueue; no setup required to offload work
	return BENCH_SUCCESS;
}

int bench_offload_create_work(void (*worker))
{
	k_work_init(&work, worker);
	return BENCH_SUCCESS;
}

int bench_offload_submit_work(void)
{
	k_work_submit(&work);
	return BENCH_SUCCESS;
}

void bench_timing_init(void)
{
	timing_init();
}

void bench_sync_ticks(void)
{
	k_sleep(K_TICKS(1));
}

void bench_timing_start(void)
{
	timing_start();
}

void bench_timing_stop(void)
{
	timing_stop();
}

bench_time_t bench_timing_counter_get(void)
{
	return timing_counter_get();
}

uint32_t bench_timing_cycles_get(bench_time_t time_start, bench_time_t time_end)
{
	return timing_cycles_get(&time_start, &time_end);
}

uint64_t bench_timing_cycles_to_ns(uint64_t cycles)
{
	return timing_cycles_to_ns(cycles);
}

int bench_sem_create(int sem_id, int initial_count, int maximum_count)
{
	k_sem_init(&semaphores[sem_id], initial_count, maximum_count);
	return BENCH_SUCCESS;
}

int bench_sem_give(int sem_id)
{
	k_sem_give(&semaphores[sem_id]);
	return BENCH_SUCCESS;
}

int bench_sem_take(int sem_id)
{
	int ret;

	ret = k_sem_take(&semaphores[sem_id], K_FOREVER);

	if (ret == 0) {
		return BENCH_SUCCESS;
	} else {
		return BENCH_ERROR;
	}
}

int bench_mutex_create(int mutex_id)
{
	k_mutex_init(&mutexes[mutex_id]);
	return BENCH_SUCCESS;
}

int bench_mutex_lock(int mutex_id)
{
	k_mutex_lock(&mutexes[mutex_id], K_FOREVER);
	return BENCH_SUCCESS;
}

int bench_mutex_unlock(int mutex_id)
{
	k_mutex_unlock(&mutexes[mutex_id]);
	return BENCH_SUCCESS;
}

void bench_irq_offload(const void *irq_offload_routine, const void *parameter)
{
	irq_offload(irq_offload_routine, parameter);
}
```

## src/bench_porting_layer_zephyr.h
```c
/* SPDX-License-Identifier: Apache-2.0 */

#ifndef PORTING_LAYER_ZEPHYR_H_
#define PORTING_LAYER_ZEPHYR_H_

#include <timing/timing.h>
#include <zephyr.h>
#include <kernel.h>

typedef timing_t bench_time_t;
typedef struct k_work bench_work;

#define TICK_SYNCH()  k_sleep(K_TICKS(1))

#endif
```

## src/bench_sem_context_switch_test.c
```c
// SPDX-License-Identifier: Apache-2.0

/**
 * @file Measure time for semaphore give and take
 *
 * This file contains the test that measures semaphore give and
 * take time between threads.
 */

#include "bench_api.h"
#include "bench_utils.h"

static bench_time_t timestamp_start_sema_t_c;
static bench_time_t timestamp_end_sema_t_c;
static bench_time_t timestamp_start_sema_g_c;
static bench_time_t timestamp_end_sema_g_c;

static struct bench_stats take_times;
static struct bench_stats give_times;

/**
 * @brief Test main function.
 *
 * High priority thread that takes semaphore.
 */
void bench_sem_context_switch_high_prio_take(void *args)
{
	ARG_UNUSED(args);

	timestamp_start_sema_t_c = bench_timing_counter_get();
	bench_sem_take(0);
	timestamp_end_sema_g_c = bench_timing_counter_get();

	bench_thread_exit();
}

/**
 * @brief Test main function.
 *
 * Low priority thread that gives semaphore.
 */
void bench_sem_context_switch_low_prio_give(int iteration)
{
	uint32_t diff;

	bench_thread_create(1, "high_prio_take", 3, bench_sem_context_switch_high_prio_take, NULL);
	bench_thread_start(1);

	timestamp_end_sema_t_c = bench_timing_counter_get();
	diff = bench_timing_cycles_get(&timestamp_start_sema_t_c, &timestamp_end_sema_t_c);
	bench_stats_update(&take_times, diff, iteration);

	timestamp_start_sema_g_c = bench_timing_counter_get();
	bench_sem_give(0);
	diff = bench_timing_cycles_get(&timestamp_start_sema_g_c, &timestamp_end_sema_g_c);
	bench_stats_update(&give_times, diff, iteration);
}

/**
 * @brief Test setup function
 */
void bench_sem_context_switch_init(void *arg)
{
	int i;

	bench_timing_init();
	bench_timing_start();

	bench_stats_reset(&take_times);
	bench_stats_reset(&give_times);

	bench_sem_create(0, 0, 1);

	bench_thread_set_priority(BENCH_LAST_PRIORITY); /* Lower main test thread priority */

	for (i = 1; i <= ITERATIONS; i++) {
		bench_sem_context_switch_low_prio_give(i);
		thinker();
		bench_sleep(BENCH_IDLE_TIME);
	}

	PRINTF("Semaphore take time (context switch) [avg min max], "
	       " %llu, %llu, %llu\n",
	       bench_timing_cycles_to_ns(take_times.avg),
	       bench_timing_cycles_to_ns(take_times.min),
	       bench_timing_cycles_to_ns(take_times.max));
	PRINTF("Semaphore give cycles (context switch) [avg min max], "
	       " %llu, %llu, %llu\n",
	       bench_timing_cycles_to_ns(give_times.avg),
	       bench_timing_cycles_to_ns(give_times.min),
	       bench_timing_cycles_to_ns(give_times.max));

	bench_timing_stop();
}

#ifdef RUN_SEM_CONTEXT_SWITCH
int main(void)
{
	bench_test_init(bench_sem_context_switch_init);
	return 0;
}
#endif
```

## src/bench_sem_signal_release_test.c
```c
// SPDX-License-Identifier: Apache-2.0

#include "bench_api.h"
#include "stdio.h"

/* Number of give / take cycles on semaphore */
#define NUM_TEST_SEM 1000

void bench_sem_signal_release(void)
{
	int i;
	uint32_t diff;
	bench_time_t timestamp_start;
	bench_time_t timestamp_end;

	/* Measure average semaphore signal time */
	bench_timing_start();

	timestamp_start = bench_timing_counter_get();

	for (i = 0; i < NUM_TEST_SEM; i++) {
		bench_sem_give(0);
	}

	timestamp_end = bench_timing_counter_get();

	bench_timing_stop();

	diff = bench_timing_cycles_get(timestamp_start, timestamp_end);

	printf("Average semaphore signal time %i cycles\n", diff / NUM_TEST_SEM);

	/* Measure average semaphore test time */
	bench_timing_start();

	timestamp_start = bench_timing_counter_get();

	for (i = 0; i < NUM_TEST_SEM; i++) {
		bench_sem_take(0);
	}

	timestamp_end = bench_timing_counter_get();

	bench_timing_stop();

	diff = bench_timing_cycles_get(timestamp_start, timestamp_end);

	printf("Average semaphore test time %i cycles\n", diff / NUM_TEST_SEM);
}

void bench_sem_signal_release_initialize(void)
{
	bench_timing_init();

	bench_sem_create(0, 0, NUM_TEST_SEM);

	bench_sem_signal_release();
}

int main(void)
{
	bench_test_init(bench_sem_signal_release_initialize);
	return 0;
}
```

## src/bench_thread_switch_yield_test.c
```c
// SPDX-License-Identifier: Apache-2.0

/**
 * @file
 *
 * @brief Measure thread yielding operations
 *
 * This modules measures two (2) different types of yield operations.
 * 1. Time to yield to a thread of equal priority (thread context switch)
 * 2. Time to yeild to a thread of lower priority (no thread context switch)
 *
 * This test assumes a uniprocessor system.
 */

#include "bench_api.h"
#include "bench_utils.h"
#include <stdlib.h>

#define THREAD_LOW      0
#define THREAD_HELPER   1

#define MAIN_PRIORITY   10


static bench_time_t  helper_start;

static struct bench_stats time_to_yield;

/**
 * @brief Reset time statistics
 */
static void reset_time_stats(void)
{
	bench_stats_reset(&time_to_yield);
}

/**
 * @brief Report the collected statistics
 */
static void report_stats(const char *description)
{
	PRINTF("Yield %s: min %llu ns, max %llu ns, avg %llu ns\n",
	       description,
	       bench_timing_cycles_to_ns(time_to_yield.min),
	       bench_timing_cycles_to_ns(time_to_yield.max),
	       bench_timing_cycles_to_ns(time_to_yield.avg));
}

/**
 * @brief Entry point to helper thread to gathering set #2 data
 */
static void bench_set2_helper(void *args)
{
	ARG_UNUSED(args);

	/*
	 * This helper thread is expected to execute to the first yield
	 * before the timing begins. The 2nd yield is expected to be part
	 * of the benchmarking.
	 */

	bench_yield();

	helper_start = bench_timing_counter_get();

	bench_yield();
}


/**
 * @brief Measure time to yield (thread context switch is performed)
 */
static void gather_set2_stats(int priority, uint32_t iteration)
{
	bench_time_t  end;

	/*
	 * Create and start the low priority helper thread. As it is of
	 * lower priority than the current thread, it is not expected
	 * to execute.
	 */

	bench_thread_create(THREAD_HELPER, "equal_priority_thread",
			    priority, bench_set2_helper, NULL);
	bench_thread_start(THREAD_HELPER);

	/*
	 * Yield to the helper thread so that it can execute to a known
	 * point so we do not include early thread startup code in the.
	 * benchmarking.
	 */

	bench_yield();

	bench_yield();
	end   = bench_timing_counter_get();

	bench_stats_update(&time_to_yield,
			   bench_timing_cycles_get(&helper_start, &end),
			   iteration);

	/*
	 * Lower the priority of the current thread to ensure that the
	 * helper thread can finish.
	 */

	bench_thread_set_priority(priority + 2);
	bench_thread_set_priority(priority);
}

/**
 * @brief Entry point to helper thread to gathering set #1 data
 */
static void bench_set1_helper(void *args)
{
	ARG_UNUSED(args);

	/* This routine intentionally does nothing */
}

/**
 * @brief Measure time to yield (but no thread context switch is done)
 */
static void gather_set1_stats(int priority, uint32_t iteration)
{
	bench_time_t  start;
	bench_time_t  end;

	/*
	 * Create and start the low priority helper thread. As it is of
	 * lower priority than the current thread, it is not expected
	 * to execute.
	 */

	bench_thread_create(THREAD_LOW, "low_priority_thread",
			    priority + 1, bench_set1_helper, NULL);
	bench_thread_start(THREAD_LOW);

	start = bench_timing_counter_get();
	bench_yield();
	end   = bench_timing_counter_get();

	bench_stats_update(&time_to_yield,
			   bench_timing_cycles_get(&start, &end),
			   iteration);

	/*
	 * Lower and then restore the priority of the current thread to allow
	 * the otherwise lower priority thread to finish.
	 */

	bench_thread_set_priority(priority + 2);
	bench_thread_set_priority(priority);
}

/**
 * @brief Test for the yield benchmarking
 */
void bench_thread_yield(void *arg)
{
	uint32_t  i;

	bench_timing_init();

	/* Lower main test thread priority */

	bench_thread_set_priority(MAIN_PRIORITY);

	/*
	 * Gather stats for yield operations for cases when there are not
	 * any thread context switches involved.
	 */

	reset_time_stats();

	bench_timing_start();

	for (i = 1; i <= ITERATIONS; i++) {
		gather_set1_stats(MAIN_PRIORITY, i);
	}

	report_stats("(no context switch)");

	reset_time_stats();

	for (i = 1; i < ITERATIONS; i++) {
		gather_set2_stats(MAIN_PRIORITY, i);
	}

	bench_timing_stop();

	report_stats("(context switch)");
}

#ifdef RUN_THREAD_SWITCH_YIELD
int main(void)
{
	bench_test_init(bench_thread_yield);
	return 0;
}
#endif
```
